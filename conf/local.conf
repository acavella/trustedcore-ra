## conf/local.conf
```bitbake
# The following variables represent local environment specifics settings 
# and should be edited by user prior to script execution. No other variables 
# or settings require modification outside of this file.

clientcert="<install-directory>/cert/client.pem"            # Client / RAMI certificate
cacert="<install-directory>/cert/ca-trust.pem"              # CA Trustchain

caecc="https://tlsldc405.example.com/certagentadmin/ca/rami"            # Address to ECC specific RAMI API interface
carsa="https://tlsldc405.example.com/certagentadmin/ca/rami"            # Address to RSA specific RAMI API interface

ecdsaprofile="x11ecdsa"         # Profile name for ECDSA
ecdhprofile="x11ecdh"           # Profile name for ECDH
rsaprofile="x11rsa"             # Profile name for RSA
```
